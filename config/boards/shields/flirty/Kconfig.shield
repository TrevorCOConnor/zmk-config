## config/boards/shields/flirty/Kconfig.shield
```kconfig
config SHIELD_FLIRTY_LEFT
    def_bool $(shields_list_contains,flirty_left)

config SHIELD_FLIRTY_RIGHT
    def_bool $(shields_list_contains,flirty_right)
```
